## boards/arm/pulga/Kconfig.board
```kconfig
# Pulga board configuration

config BOARD_PULGA
	bool "Pulga"
	depends on SOC_NRF52840_QIAA
```

## boards/arm/pulga/Kconfig.defconfig
```kconfig
# Pulga board configuration

if BOARD_PULGA

config BOARD
	default "pulga"

config BT_CTLR
	default BT

endif # BOARD_PULGA
```
